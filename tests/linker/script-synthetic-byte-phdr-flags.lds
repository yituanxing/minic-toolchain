/* A writable PT_LOAD is not evidence that a linker-generated BYTE section
 * has SHF_WRITE.  Linux's .edata_padding is a script-only PROGBITS section
 * even when it inherits a PT_LOAD with explicit RWX permissions. */
OUTPUT_FORMAT("elf64-x86-64")
OUTPUT_ARCH(i386:x86-64)
ENTRY(_start)
PHDRS { text PT_LOAD FLAGS(7); }
SECTIONS {
  . = 0x400000;
  .text : { *(.text) } :text
  . = ALIGN(0x1000);
  .data : { *(.data) } :text
  . = ALIGN(0x100);
  .edata_padding : { BYTE(0); . = ALIGN(0x200); }
}
